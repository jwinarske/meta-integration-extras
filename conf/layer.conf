## conf/layer.conf
```bitbake
# We have a conf and classes directory, append to BBPATH
BBPATH .= ":${LAYERDIR}"

BBFILES += "${LAYERDIR}/recipes*/*/*.bb ${LAYERDIR}/recipes*/*/*.bbappend ${LAYERDIR}/images/*.bb"

BBFILE_COLLECTIONS += "meta-integration-extras"
BBFILE_PATTERN_meta-integration-extras := "^${LAYERDIR}/"
BBFILE_PRIORITY_meta-integration-extras = "12"

LAYERSERIES_COMPAT_meta-integration-extras = "kirkstone"
```
